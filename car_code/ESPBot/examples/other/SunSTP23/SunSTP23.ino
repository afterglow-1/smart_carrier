#include <Arduino.h>

#define TIMEOUT_MS 100
#define POINT_PER_PACK 12 //STP23 12点数据
#define HEADER 0x54 //测距数据结构体帧头
#define TXD2 17
#define RXD2 16

typedef struct __attribute__((packed)) {
uint16_t distance;//距离
uint8_t intensity;//光强
} LidarPointStructDef;

//测距数据包结构体
typedef struct __attribute__((packed)) {
uint8_t header;
uint8_t ver_len;
uint16_t temperature;
uint16_t start_angle;
LidarPointStructDef point[POINT_PER_PACK];
uint16_t end_angle;
uint16_t timestamp;
uint8_t crc8;
}LiDARFrameTypeDef

static const uint8_t CrcTable[256] ={
0x00, 0x4d, 0x9a, 0xd7, 0x79, 0x34, 0xe3,
0xae, 0xf2, 0xbf, 0x68, 0x25, 0x8b, 0xc6, 0x11, 0x5c, 0xa9, 0xe4, 0x33,
0x7e, 0xd0, 0x9d, 0x4a, 0x07, 0x5b, 0x16, 0xc1, 0x8c, 0x22, 0x6f, 0xb8,
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0x5a, 0x06, 0x4b, 0x9c, 0xd1, 0x7f, 0x32, 0xe5, 0xa8
};

void setup() {
  //Serial2.begin(115200, SERIAL_8N1, 32, 33);//独立版
    //            baud    config      rx  tx
    Serial2.begin(921600, SERIAL_8N1, RXD2, TXD2);//二合一版
    Serial1.begin(921600, SERIAL_8N1, RXD1, TXD1);//二合一版
  Serial.begin(115200);
}

void loop() {
  if (Serial2.available() > 0) {
    int inByte = Serial2.read();
    // Do something with the incoming data
  }
}

//接收响应包 
void readData(){
    uint32_t start_time = millis();
    
    // responsePack.recv_status = 0; //重置标志位
    static uint8_t state = 0;//数据接收状态位
    static uint8_t crc = 0;//校验和
    static uint8_t cnt = 0; // 一个数据帧12个点计数
    
    while(true){
        // 超时判断
        if((millis() - start_time) > TIMEOUT_MS){
            return;
        }
        // 等待有字节读入
        if (serial->available()==0){
            continue;
        }
        uint8_t curByte = serial->read();
        uint8_t curIdx = responsePack.recv_cnt;
        responsePack.recv_buffer[curIdx] = curByte; // 接收一个字节
        responsePack.recv_cnt+=1; // 计数自增
        
        // 数据接收是否完成
        if(curIdx==1){
            // 校验帧头
            responsePack.header = responsePack.recv_buffer[curIdx-1] | curByte << 8;
            if(responsePack.header!=FSUS_PACK_RESPONSE_HEADER){
                return FSUS_STATUS_WRONG_RESPONSE_HEADER;
            }
        }else if (curIdx==2){
            // 载入cmdId
            responsePack.cmdId = curByte;
            // 检查cmdId是否满足指令范围
            if(responsePack.cmdId > FSUS_CMD_NUM){
                return FSUS_STATUS_UNKOWN_CMD_ID;
            }
        }else if (curIdx==3){
            // 载入Size
            responsePack.content_size = curByte;
            // 判断size是否合法
            if(responsePack.content_size > FSUS_PACK_RESPONSE_MAX_SIZE){
                return FSUS_STATUS_SIZE_TOO_BIG;
            }
        }else if (curIdx < 4+responsePack.content_size){
            // 填充内容
            responsePack.content[curIdx-4] = curByte;
        }else{
            // 接收校验合
            responsePack.checksum = curByte;
            // 检查校验和是否匹配
            FSUS_CHECKSUM_T checksum = calcPackChecksum(&responsePack);
            // if (responsePack.cmdId == FSUS_CMD_QUERY_ANGLE){
            //     checksum -= 0x03;// TODO Delete 不知道为什么要这样
            // }
            
            if (checksum != responsePack.checksum){
                return FSUS_STATUS_CHECKSUM_ERROR;
            }else{
                return FSUS_STATUS_SUCCESS;
            }
        }
    }
}

void setup() {
  Serial.begin(9600);
  while(Serial.read()>=0){}//清空缓存区
}

void loop() {
  if (Serial.available() >= 47) {
    byte data[47];
    Serial.readBytes(data, 47);
    // Do something with the incoming data
  }
}


uint8_t CalCRC8(uint8_t *p, uint8_t len){
uint8_t crc = 0;
uint16_t i;
for (i = 0; i < len; i++){
crc = CrcTable[(crc ^ *p++) & 0xff];
}
return crc;
}